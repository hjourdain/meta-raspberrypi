## conf/machine/raspberrypi3-64.conf
```bitbake
#@TYPE: Machine
#@NAME: RaspberryPi 3 Development Board
#@DESCRIPTION: Machine configuration for the RaspberryPi 3 in 64 bits mode

DEFAULTTUNE ?= "cortexa53-64"

MACHINEOVERRIDES = "raspberrypi3:raspberrypi:${MACHINE}"

MACHINE_EXTRA_RRECOMMENDS += "linux-firmware-bcm43430"

PREFERRED_VERSION_linux-raspberrypi_raspberrypi3-64 ?= "4.7.%"

require conf/machine/include/tune-cortexa53.inc
include conf/machine/include/rpi-base.inc

SERIAL_CONSOLE = "115200 ttyS0"
VC4_CMA_SIZE ?= "cma-256"

UBOOT_MACHINE = "rpi_3_config"
```
